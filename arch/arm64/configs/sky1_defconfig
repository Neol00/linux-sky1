## drivers/media/platform/cix/Kconfig
```kconfig
# SPDX-License-Identifier: GPL-2.0-only
source "drivers/media/platform/cix/linlon-aeu/Kconfig"

config CSI_DMA
	tristate "CIX CSI DMA driver"
	depends on VIDEO_DEV
	select VIDEOBUF2_DMA_CONTIG
	help
	  CIX platform CSI DMA capture driver.
```
